// edge_personalization_no_replay.ino
// ─────────────────────────────────────────────────────────────────────────────
// ESP32 on-device incremental learning for stress detection.
//
// EXACT hardware equivalent of part2_edge_simulation_no_replay.py:
//   • Single-stage global StandardScaler  (no smart-card / two-stage scaling)
//   • NO replay buffer  — update on the current sample only, then discard
//   • 10 SGD inner-loop iterations per sample  (matches Python inner for-loop)
//   • EWC penalty with lambda=0.001 and Fisher diagonal from training set
//   • Gradient clipping to [-1, 1] on every gradient  (weight & bias)
//   • Learning rate = 0.1
//   • Features arrive PRE-SCALED from send_data_to_esp.py using scaler
//     parameters stored in output/generic_model.json (same source as
//     model_weights.h).  The ESP32 therefore receives the same floats that
//     the Python simulation operates on.
//
// Header required:  output/model_weights.h   (generated by export_generic_model.py)
//   Copy model_weights.h into this sketch folder before compiling.
// ─────────────────────────────────────────────────────────────────────────────

#include <Arduino.h>
#include <math.h>
#include "model_weights.h"   // GENERIC_WEIGHTS, GENERIC_BIAS,
                              // SCALER_MEAN, SCALER_STD,
                              // F_WEIGHTS, F_BIAS, NUM_FEATURES

// ──────────────────────────────────────────────────────────────────────────────
// Mutable model state (copied from flash into RAM at boot)
// ──────────────────────────────────────────────────────────────────────────────
float current_weights[NUM_FEATURES];
float current_bias;

// ──────────────────────────────────────────────────────────────────────────────
// Hyper-parameters  — must match the Python simulation exactly
// ──────────────────────────────────────────────────────────────────────────────
const float lr         = 0.1f;
const float ewc_lambda = 0.001f;
const int   SGD_STEPS  = 10;       // inner-loop iterations per sample

// ──────────────────────────────────────────────────────────────────────────────
// Metrics
// ──────────────────────────────────────────────────────────────────────────────
int true_positives    = 0;
int false_positives   = 0;
int true_negatives    = 0;
int false_negatives   = 0;
int total_predictions = 0;
int correct_predictions = 0;

// ──────────────────────────────────────────────────────────────────────────────
// Inference scratch
// ──────────────────────────────────────────────────────────────────────────────
float temp_features[NUM_FEATURES];
bool  features_ready = false;
int   last_prediction = 0;

// ──────────────────────────────────────────────────────────────────────────────
// Initialisation
// ──────────────────────────────────────────────────────────────────────────────
void loadModelFromFlash() {
    current_bias = GENERIC_BIAS;
    for (int i = 0; i < NUM_FEATURES; i++) {
        current_weights[i] = GENERIC_WEIGHTS[i];
    }
    Serial.println("SYS: Generic model loaded (no-replay, single-stage scaler).");
}

// ──────────────────────────────────────────────────────────────────────────────
// Core maths
// ──────────────────────────────────────────────────────────────────────────────

// Numerically stable sigmoid — matches Python:
//   1 / (1 + np.exp(-np.clip(x, -500, 500)))
float sigmoid(float x) {
    if (x >  50.0f) return 1.0f;
    if (x < -50.0f) return 0.0f;
    return 1.0f / (1.0f + expf(-x));
}

// Forward pass using CURRENT (personalised) weights
float predict_prob(float* features) {
    float z = current_bias;
    for (int i = 0; i < NUM_FEATURES; i++) {
        z += current_weights[i] * features[i];
    }
    return sigmoid(z);
}

// ──────────────────────────────────────────────────────────────────────────────
// SGD update with EWC — no replay
// Mirrors the Python inner loop exactly:
//
//   for _ in range(10):
//       i_z      = dot(inc_weights, features) + inc_bias
//       prob     = sigmoid(i_z)
//       error    = label - prob
//       clipped  = clip(error, -1, 1)
//       ewc_pen_w = ewc_lambda * F_weights * (inc_weights - generic_weights)
//       ewc_pen_b = ewc_lambda * F_bias    * (inc_bias    - generic_bias   )
//       grad_w   = clip(clipped * features - ewc_pen_w, -1, 1)
//       grad_b   = clip(clipped            - ewc_pen_b, -1, 1)
//       inc_weights += lr * grad_w
//       inc_bias    += lr * grad_b
// ──────────────────────────────────────────────────────────────────────────────
void sgd_update_no_replay(float* features, uint8_t label) {
    for (int step = 0; step < SGD_STEPS; step++) {
        float prob    = predict_prob(features);
        float error   = (float)label - prob;
        float clipped = fmaxf(-1.0f, fminf(1.0f, error));

        // Bias
        float ewc_pen_b = ewc_lambda * F_BIAS * (current_bias - GENERIC_BIAS);
        float grad_b    = clipped - ewc_pen_b;
        grad_b = fmaxf(-1.0f, fminf(1.0f, grad_b));
        current_bias += lr * grad_b;

        // Weights
        for (int i = 0; i < NUM_FEATURES; i++) {
            float ewc_pen = ewc_lambda * F_WEIGHTS[i] * (current_weights[i] - GENERIC_WEIGHTS[i]);
            float grad_w  = clipped * features[i] - ewc_pen;
            grad_w = fmaxf(-1.0f, fminf(1.0f, grad_w));
            current_weights[i] += lr * grad_w;
        }
    }
    // NOTE: No add_to_buffer() — this is the no-replay variant.
}

// ──────────────────────────────────────────────────────────────────────────────
// Serial protocol
// ──────────────────────────────────────────────────────────────────────────────

// Receives a comma-separated line of pre-scaled floats from send_data_to_esp.py.
// The Python host applies the SAME StandardScaler (loaded from generic_model.json)
// so the values arriving here are identical to X_test_scaled[i] in the Python sim.
void parse_features(String line) {
    int feature_index = 0;
    int start_pos     = 0;
    int comma_pos     = line.indexOf(',');

    while (comma_pos != -1 && feature_index < NUM_FEATURES - 1) {
        temp_features[feature_index++] = line.substring(start_pos, comma_pos).toFloat();
        start_pos = comma_pos + 1;
        comma_pos = line.indexOf(',', start_pos);
    }
    if (feature_index < NUM_FEATURES) {
        temp_features[feature_index] = line.substring(start_pos).toFloat();
    }

    // Python sim:  g_pred = 1 if sigmoid(dot(generic_weights, features) + generic_bias) >= 0.5 else 0
    //              i_pred = 1 if sigmoid(dot(inc_weights,     features) + inc_bias    ) >= 0.5 else 0
    // Here we track only the incremental model (current_weights) — the generic
    // model baseline is already captured in the offline export metrics.
    features_ready   = true;
    float prob       = predict_prob(temp_features);
    last_prediction  = (prob >= 0.5f) ? 1 : 0;

    Serial.print("Pred:");
    Serial.println(last_prediction);
}

// Receives "label:<0|1>" after the corresponding features have been parsed.
void parse_label(String line) {
    if (!features_ready) {
        Serial.println("ERR: Label received before features.");
        return;
    }

    int colon_pos = line.indexOf(':');
    if (colon_pos == -1) return;

    uint8_t true_label = (uint8_t)line.substring(colon_pos + 1).toInt();

    // ── Track metrics (Python sim uses accuracy_score / f1_score at the end) ──
    total_predictions++;
    if (last_prediction == true_label) {
        correct_predictions++;
        if (true_label == 1) true_positives++;
        else                 true_negatives++;
    } else {
        if (true_label == 1) false_negatives++;
        else                 false_positives++;
    }

    // ── Personalise: 10 SGD steps, NO replay (exact Python sim behaviour) ──
    sgd_update_no_replay(temp_features, true_label);

    features_ready = false;
    Serial.println("ACK");
}

// Prints shift-end metrics and resets counters.
// Python sim equivalent: accuracy_score(), f1_score(), confusion_matrix() at end of subject loop.
void handle_end_shift() {
    float accuracy = (total_predictions > 0)
        ? ((float)correct_predictions / total_predictions)
        : 0.0f;

    // F1 = 2*TP / (2*TP + FP + FN)
    float f1 = 0.0f;
    int denom = 2 * true_positives + false_positives + false_negatives;
    if (denom > 0) {
        f1 = (float)(2 * true_positives) / (float)denom;
    }

    Serial.println("--- END OF SHIFT METRICS (no-replay) ---");
    Serial.print("Accuracy: ");  Serial.println(accuracy, 4);
    Serial.print("F1 Score: ");  Serial.println(f1, 4);
    Serial.println("Confusion Matrix (TN FP / FN TP):");
    Serial.print("[["); Serial.print(true_negatives);
    Serial.print("  "); Serial.print(false_positives); Serial.println("]");
    Serial.print(" ["); Serial.print(false_negatives);
    Serial.print("  "); Serial.print(true_positives);  Serial.println("]]");

    // Reset all state for the next shift / subject
    total_predictions   = 0; correct_predictions = 0;
    true_positives      = 0; false_positives     = 0;
    true_negatives      = 0; false_negatives     = 0;

    // Reload generic weights so the next shift starts from scratch (matches
    // the Python sim which resets inc_weights = generic_weights per subject)
    loadModelFromFlash();
}

// ──────────────────────────────────────────────────────────────────────────────
// Arduino entry points
// ──────────────────────────────────────────────────────────────────────────────
void setup() {
    Serial.begin(115200);
    while (!Serial) { ; }
    loadModelFromFlash();
    Serial.println("SYS: ESP32 Edge Personalisation (No-Replay) Initialised.");
    Serial.println("SYS: Awaiting pre-scaled feature vectors from host.");
}

void loop() {
    if (Serial.available() > 0) {
        String line = Serial.readStringUntil('\n');
        line.trim();
        if (line.length() == 0) return;

        if      (line == "END_SHIFT")       handle_end_shift();
        else if (line.startsWith("label:")) parse_label(line);
        else                                parse_features(line);
    }
}
